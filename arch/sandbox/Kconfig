## arch/sandbox/Kconfig
```kconfig
menu "Sandbox architecture"
	depends on SANDBOX

config SYS_ARCH
	default "sandbox"

config SYS_BOARD
	default "sandbox"

config SYS_CONFIG_NAME
	default "sandbox"

choice
	prompt "Target select"

config TARGET_SANDBOX
	bool "Support sandbox"

config TARGET_CHROMEOS_SANDBOX
	bool "Support Chrome OS sandbox"

endchoice

source "board/sandbox/Kconfig"

config DM_TEST
	default y

config PCI
	bool "PCI support"
	help
	  Enable support for PCI (Peripheral Interconnect Bus), a type of bus
	  used on some devices to allow the CPU to communicate with its
	  peripherals.

config NET
	default y

config NETDEVICES
	default y

config DM_ETH
	default y

config ETH_SANDBOX_RAW
	default y

endmenu
```

## configs/jetson-tk1_defconfig
```kconfig
CONFIG_ARM=y
CONFIG_TEGRA=y
CONFIG_TEGRA124=y
CONFIG_TARGET_JETSON_TK1=y
CONFIG_DEFAULT_DEVICE_TREE="tegra124-jetson-tk1"
CONFIG_DISPLAY_PORT=y
CONFIG_VIDEO_TEGRA124=y
```
